## main/Kconfig
```kconfig
menu "Configuration"
    config LOCK_DELAY
        int "LOCK DELAY"
        help
          The time lock will be locked
	config WIFI_SSID
		string "WIFI SSID"
		help
			Enter the wifi network SSID
	config WIFI_PASSWORD
		string "WIFI PASSWORD"
		help
			Enter the wifi network PASSWORD
	config MQTT_URI
		string "MQTT URI"
		help
			Enter the MQTT uri
endmenu
```
